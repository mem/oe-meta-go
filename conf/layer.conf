## conf/layer.conf
```bitbake
# We have a conf and classes directory, add to BBPATH
BBPATH .= ":${LAYERDIR}"

# We have recipes-* directories, add to BBFILES
BBFILES += "${LAYERDIR}/recipes-*/*/*.bb ${LAYERDIR}/recipes-*/*/*.bbappend"

BBFILE_COLLECTIONS += "go"
BBFILE_PATTERN_go = "^${LAYERDIR}/"
BBFILE_PRIORITY_go = "1"

# This should only be incremented on significant changes that will
# cause compatibility issues with other layers
LAYERVERSION_skeleton = "1"

LAYERDEPENDS_skeleton = "core"

# Yocto Project Compatible version 2 standard requires setting it
LAYERSERIES_COMPAT_go = "pyro rocko sumo"
```
